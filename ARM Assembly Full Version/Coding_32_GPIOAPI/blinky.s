RCC_BASE		EQU		0x40023800
RCC_AHB1ENR		EQU		0x40023830 	;RCC_BASE+30
GPIOD_BASE		EQU		0x40020C00	
GPIOD_MODER		EQU		0x40020C00
GPIOD_ODR		EQU		0x40020C14	;OFFSET=0x14	
	
GPIODEN			EQU		1<<3
MODER12_OUT		EQU		1<<24
MODER13_OUT		EQU		1<<26	
MODER14_OUT		EQU		1<<28
MODER15_OUT		EQU		1<<30

SETBLUE			EQU		1<<15
SETRED			EQU		1<<14	
SETORANGE		EQU		1<<13
SETGREEN		EQU		1<<12

DELAY			EQU		0x000F
	
ONESEC			EQU		5333333
HSEC			EQU		266667
FSEC			EQU		106667
	
		AREA	|.text|,CODE,READONLY,ALIGN=2
		THUMB
		EXPORT	__main
			
__main
		BL		GPIOD_Init
		

GPIOD_Init
		LDR		R1,=RCC_AHB1ENR
		LDR		R0,[R1]
		ORR		R0,R0,#GPIODEN
		STR		R0,[R1]
		
		LDR		R1,=GPIOD_MODER
		;LDR		R0,[R1]
		;ORR		R0,R0,MODER12_OUT
		;ORR		R0,R0,MODER13_OUT
		;ORR		R0,R0,MODER14_OUT
		;ORR		R0,R0,MODER15_OUT
		LDR		R0,=(MODER12_OUT|MODER13_OUT|MODER14_OUT|MODER15_OUT)
		STR		R0,[R1]
		MOV		R0,#0
		LDR		R2,=GPIOD_ODR
		

Blink
		MOVW	R1,#SETGREEN
		STR		R1,[R2]
		LDR		R3,=ONESEC
		BL		Delay
		
		MOVW	R1,#SETBLUE
		STR		R1,[R2]
		LDR		R3,=HSEC
		BL		Delay		
		
		MOVW	R1,#SETRED
		STR		R1,[R2]
		LDR		R3,=HSEC
		BL		Delay

		MOVW	R1,#SETORANGE
		STR		R1,[R2]
		LDR		R3,=FSEC
		BL		Delay
		
		B		Blink
Delay
		SUBS	R3,R3,#1
		BNE		Delay
		BX		LR
		ALIGN
			
		END