
SYSCTL_RCC_AHB1ENR EQU 0x40023830
SYSCTL_GPIO_PORTD_DIR EQU 0x40020C00
SYSCTL_GPIO_PORTD_SPEED EQU 0x40020C08
SYSCTL_GPIO_PORTD_PULLUPDN EQU 0x40020C0C
SYSCTL_GPIO_PORTD_BSRR EQU	0x40020C18
SYSCTL_GPIO_PORTD_ODR EQU	0x40020C14	

SYSCTL_GPIO_PORTA_DIR EQU 0x40020000
SYSCTL_GPIO_PORTA_SPEED EQU 0x40020008
SYSCTL_GPIO_PORTA_PULLUPDN EQU 0x4002000C
SYSCTL_GPIO_PORTA_BSRR EQU	0x40020018
SYSCTL_GPIO_PORTA_IDR EQU 0x40020010
	
PORTA_DIR_VALUE EQU 0xFFFFF3F3	
PORTA_SPEED_VALUE EQU 0x404
PORTA_PULLUPDN_VALUE EQU 0x404
	
SECOND_DIV_FIVE EQU 1066666	
SET_VALUE EQU 0x4000
RESET_VALUE EQU 0x2000
BOTH_VALUE EQU 0x1000	
	
				AREA |.text|,CODE,READONLY,ALIGN=2
				THUMB
				EXPORT Main
					
					

Main
		BL		GPIOD_Init
LOOP
		LDR 	R0,=SECOND_DIV_FIVE
		BL		DELAY
		BL		INPUT
		CMP		R0,#0x02
		BEQ		LIGHT1_ON
		CMP		R0,#0x20
		;BL		INPUT
		;CMP		R0,#0x01
		BEQ		LIGHT2_ON
		CMP		R0,#0x00
		BEQ		LIGHT3_ON
		LDR		R0,=SECOND_DIV_FIVE
		BL		DELAY
		;BL		LIGHT_ON
		B		LOOP
		
DELAY
		;LDR R0,=SECOND_DIV_FIVE
		SUBS 	R0,R0,#1
		BNE 	DELAY
		BX		LR


GPIOD_Init
		LDR		R1,=SYSCTL_RCC_AHB1ENR
		LDR		R0,[R1]
		ORR		R0,R0,#0x09 ;enable gpiod
		STR		R0,[R1]
		
		;RCC Base Adress 0x40023800
		;RCC_AHB1ENR Offset Address 0x30
;SYSCTL_RCC_AHB1ENR EQU 0x40023830		
		
		
		;0x40020C00 ;GPIOD Base Address
		;0x0 ;GPIOD Mode Register
;SYSCTL_GPIO_PORTD_DIR EQU 0x40020C00
		LDR  	R1,=SYSCTL_GPIO_PORTD_DIR
		LDR		R0,[R1]
		ORR 	R0,R0,#0x15000000 ;pins 14, 13 and 12 output 
		STR		R0,[R1]
		
		;0x04 ;GPIOD OUTPUT TYPE REGISTER
;SYSCTL_GPIO_PORTD_SPEED EQU 0X40020C08
		LDR 	R1,=SYSCTL_GPIO_PORTD_SPEED
		LDR		R0,[R1]
		ORR 	R0,R0,#0x15000000
		STR		R0,[R1]
		
		;0X0C ;GPIOD PORT PULLUP/DOWN REGISTER
;SYSCTL_GPIO_PORTD_PULLUPDN EQU 0X40020C0C
		LDR 	R1,=SYSCTL_GPIO_PORTD_PULLUPDN
		LDR		R0,[R1]
		ORR 	R0,R0,#0x15000000
		STR		R0,[R1]
		
;Set pin PA0 an PA5 as input
		LDR  	R1,=SYSCTL_GPIO_PORTA_DIR
		LDR		R0,[R1]
		LDR		R2,=PORTA_DIR_VALUE
		AND 	R0,R0,R2 ;(0b 1111,1111,1111,1111,1111,0011,1111,0011)	
		;MOV		R0,#0
		STR		R0,[R1]

		LDR 	R1,=SYSCTL_GPIO_PORTA_SPEED
		LDR		R0,[R1]
		LDR		R2,=PORTA_SPEED_VALUE
		ORR 	R0,R0,R2; #0x0101 ;(0b 0000 0100 0000 0001)
		STR		R0,[R1]

		LDR 	R1,=SYSCTL_GPIO_PORTA_PULLUPDN
		LDR		R0,[R1]
		LDR		R2,=PORTA_PULLUPDN_VALUE
		ORR 	R0,R0,R2;#0x401 ;(0B 0100 0000 0001)
		STR		R0,[R1]
		
		BX		LR
		

LIGHT1_ON
		;0X18 ;GPIOD PORT BSRR REGISTER
;SYSCTL_GPIO_PORTD_BSRR EQU	0X40020C18
		LDR 	R1,=SYSCTL_GPIO_PORTD_ODR
		LDR		R0,=SET_VALUE
		;LDR		R2,=SET_VALUE
		;EOR		R0,R0,R2		
		;ORR		R0,R0,R2
		;ORR		R0,R0,#0x00004000
		STR		R0,[R1]
		BX		LR

LIGHT2_ON
		;0X18 ;GPIOD PORT BSRR REGISTER
;SYSCTL_GPIO_PORTD_BSRR EQU	0X40020C18
		LDR 	R1,=SYSCTL_GPIO_PORTD_ODR
		LDR		R0,=RESET_VALUE
		;LDR		R2,=RESET_VALUE
		;EOR		R0,R0,R2
		;ORR		R0,R0,R2
		STR		R0,[R1]
		BX		LR

LIGHT3_ON
		LDR 	R1,=SYSCTL_GPIO_PORTD_ODR
		LDR		R0,=BOTH_VALUE
		STR		R0,[R1]
		BX		LR
INPUT
		LDR 	R1,=SYSCTL_GPIO_PORTA_IDR
		LDR 	R0,[R1]
		AND 	R0,R0,#0x22 ;(0B 0010 0001)
		BX		LR
		
		ALIGN
		END
		