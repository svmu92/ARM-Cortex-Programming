;Activate clock of the port in RCGCGPIO registers
;Wait for status bit to be true in PRGPIO
;Unlock pin - only needed for PD7
;Set direction of pin in DIR register
;Enable pin in DEN register

;Writing/Reading data: GPIODATA register

SYSCTL_RCC_AHB1ENR EQU 0x40023830
SYSCTL_GPIO_PORTD_DIR EQU 0x40020C00
SYSCTL_GPIO_PORTD_SPEED EQU 0X40020C08
SYSCTL_GPIO_PORTD_PULLUPDN EQU 0X40020C0C
SYSCTL_GPIO_PORTD_BSRR EQU	0X40020C18
	
	
				AREA |.text|,CODE,READONLY,ALIGN=2
				THUMB
				EXPORT Main
					
					

Main
		BL		GPIOD_Init
LOOP
		BL		LIGHT_ON
		B		LOOP
		

GPIOD_Init
		LDR		R1,=SYSCTL_RCC_AHB1ENR
		LDR		R0,[R1]
		ORR		R0,R0,#0x08
		STR		R0,[R1]
		
		;RCC Base Adress 0x40023800
		;RCC_AHB1ENR Offset Address 0x30
;SYSCTL_RCC_AHB1ENR EQU 0x40023830		
		
		
		;0x40020C00 ;GPIOD Base Address
		;0x0 ;GPIOD Mode Register
;SYSCTL_GPIO_PORTD_DIR EQU 0x40020C00
		LDR  	R1,=SYSCTL_GPIO_PORTD_DIR
		LDR		R0,[R1]
		ORR 	R0,R0,#0x10000000
		STR		R0,[R1]
		
		;0x04 ;GPIOD OUTPUT TYPE REGISTER
;SYSCTL_GPIO_PORTD_SPEED EQU 0X40020C08
		LDR 	R1,=SYSCTL_GPIO_PORTD_SPEED
		LDR		R0,[R1]
		ORR 	R0,R0,#0x10000000
		STR		R0,[R1]
		
		;0X0C ;GPIOD PORT PULLUP/DOWN REGISTER
;SYSCTL_GPIO_PORTD_PULLUPDN EQU 0X40020C0C
		LDR 	R1,=SYSCTL_GPIO_PORTD_PULLUPDN
		LDR		R0,[R1]
		ORR 	R0,R0,#0x10000000
		STR		R0,[R1]
		
		BX		LR
		

LIGHT_ON
		;0X18 ;GPIOD PORT BSRR REGISTER
;SYSCTL_GPIO_PORTD_BSRR EQU	0X40020C18
		LDR 	R1,=SYSCTL_GPIO_PORTD_BSRR
		LDR		R0,[R1]
		ORR		R0,R0,#0X00004000
		STR		R0,[R1]
		BX		LR
		
		ALIGN
		END

